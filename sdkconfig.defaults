## sdkconfig.defaults
```kconfig
# sdkconfig.defaults
#
# Project-wide custom configuration applied on top of the ESP-IDF defaults for
# every build target. These are the intentional deltas between this project's
# sdkconfig and a blank ESP32-S3 project; pure ESP-IDF component defaults and
# example-only / version-specific / legacy-alias symbols are deliberately left out.
#
# Do NOT add target-specific options here so the file stays portable across targets.

#
# Partition table (custom layout)
#
CONFIG_PARTITION_TABLE_CUSTOM=y
CONFIG_PARTITION_TABLE_CUSTOM_FILENAME="partitions.csv"

#
# Compiler: optimize for size, silent assertions
#
CONFIG_COMPILER_OPTIMIZATION_SIZE=y
CONFIG_COMPILER_OPTIMIZATION_ASSERTIONS_SILENT=y

#
# Run the CPU at 240 MHz
#
CONFIG_ESP_DEFAULT_CPU_FREQ_MHZ_240=y

#
# Task stack sizes
#
CONFIG_ESP_MAIN_TASK_STACK_SIZE=10240
CONFIG_ESP_IPC_TASK_STACK_SIZE=1536
CONFIG_ESP_TIMER_TASK_STACK_SIZE=2048

#
# FreeRTOS: 1 kHz tick + runtime stats/trace (used by the monitor/stats apps)
#
CONFIG_FREERTOS_HZ=1000
CONFIG_FREERTOS_USE_TRACE_FACILITY=y
CONFIG_FREERTOS_GENERATE_RUN_TIME_STATS=y
CONFIG_FREERTOS_VTASKLIST_INCLUDE_COREID=y

#
# FATFS: long filename support (on stack) + volume labels (required for ExFAT)
#
CONFIG_FATFS_LFN_STACK=y
CONFIG_FATFS_USE_LABEL=y

#
# PHY: don't store calibration data in NVS (full calibration each boot)
#
# CONFIG_ESP_PHY_CALIBRATION_AND_DATA_STORAGE is not set

#
# Keep GDMA control functions in IRAM (performance)
#
CONFIG_GDMA_CTRL_FUNC_IN_IRAM=y

#
# mbedTLS: enable CMAC (required by mesh crypto), drop error strings to save flash
#
CONFIG_MBEDTLS_CMAC_C=y
# CONFIG_MBEDTLS_ERROR_STRINGS is not set

#
# Drop esp_err_to_name() lookup table to save flash
#
# CONFIG_ESP_ERR_TO_NAME_LOOKUP is not set
```
